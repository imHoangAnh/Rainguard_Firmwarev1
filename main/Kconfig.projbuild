## main/Kconfig.projbuild
```kconfig
menu "RainGuard Configuration"

    config WIFI_SSID
        string "WiFi SSID"
        default "myssid"
        help
            SSID (network name) for WiFi connection.

    config WIFI_PASSWORD
        string "WiFi Password"
        default "mypassword"
        help
            WiFi password (WPA or WPA2).

    config MQTT_BROKER_URI
        string "MQTT Broker URI"
        default "mqtts://broker.example.com:8883"
        help
            MQTT broker URI (mqtt:// or mqtts:// for SSL).

    config MQTT_TOPIC_PREFIX
        string "MQTT Topic Prefix"
        default "train/data"
        help
            MQTT topic prefix for publishing sensor data.

    config DEVICE_ID
        string "Device ID"
        default "rainguard_001"
        help
            Unique device identifier for MQTT topics.

    config CLOUDINARY_UPLOAD_URL
        string "Cloudinary Upload URL"
        default "https://api.cloudinary.com/v1_1/your_cloud_name/image/upload"
        help
            Cloudinary API upload URL endpoint.

    config CLOUDINARY_UPLOAD_PRESET
        string "Cloudinary Upload Preset"
        default "your_upload_preset"
        help
            Cloudinary upload preset name.

    config SENSOR_INTERVAL_MS
        int "Sensor Reading Interval (ms)"
        default 5000
        range 1000 60000
        help
            Interval in milliseconds between sensor readings.

    config CAMERA_INTERVAL_MS
        int "Camera Capture Interval (ms)"
        default 30000
        range 5000 300000
        help
            Interval in milliseconds between camera captures.

endmenu
```

## sdkconfig.defaults
```kconfig
# RainGuard Firmware - SDK Configuration Defaults
# Target: ESP32-S3-WROOM N16R8 (16MB Flash, 8MB PSRAM)

# Target Configuration
CONFIG_IDF_TARGET="esp32s3"

# PSRAM Configuration (CRITICAL: Octal Mode)
CONFIG_ESP32S3_SPIRAM_SUPPORT=y
CONFIG_SPIRAM=y
CONFIG_SPIRAM_MODE_OCT=y
CONFIG_SPIRAM_SPEED_80M=y
CONFIG_SPIRAM_USE_MALLOC=y
CONFIG_SPIRAM_USE_CAPS_ALLOC=y
CONFIG_SPIRAM_MEMTEST=y
CONFIG_SPIRAM_TRY_ALLOCATE_WIFI_LWIP=y

# Flash Configuration (QIO Mode)
CONFIG_ESPTOOLPY_FLASHSIZE_16MB=y
CONFIG_ESPTOOLPY_FLASHMODE_QIO=y
CONFIG_ESPTOOLPY_FLASHFREQ_80M=y
CONFIG_ESPTOOLPY_FLASH_SAMPLE_MODE_STR=y

# Partition Table Configuration
CONFIG_PARTITION_TABLE_CUSTOM=y
CONFIG_PARTITION_TABLE_CUSTOM_FILENAME="partitions.csv"
CONFIG_PARTITION_TABLE_FILENAME="partitions.csv"

# HTTP Client (for Cloudinary)
CONFIG_ESP_HTTP_CLIENT_ENABLE_HTTPS=y

# FreeRTOS Configuration
CONFIG_FREERTOS_HZ=1000

# WiFi Configuration
CONFIG_ESP32_WIFI_STATIC_RX_BUFFER_NUM=10
CONFIG_ESP32_WIFI_DYNAMIC_RX_BUFFER_NUM=32

# MQTT Configuration
CONFIG_MQTT_PROTOCOL_311=y
CONFIG_MQTT_TRANSPORT_SSL=y
CONFIG_MQTT_TRANSPORT_WEBSOCKET=y
CONFIG_MQTT_TRANSPORT_WEBSOCKET_SECURE=y

# Logging
CONFIG_LOG_DEFAULT_LEVEL_DEBUG=y
CONFIG_LOG_MAXIMUM_LEVEL_VERBOSE=y
```
